## deploy/package/combinationlock/Config.in
```kconfig
config BR2_PACKAGE_COMBINATIONLOCK
    bool "combinationlock"
    depends on BR2_PACKAGE_WIRINGPI
    help
      Combination lock using wiringpi
```

## package/Config.in
```kconfig
config BR2_PACKAGE_COMBINATIONLOCK
    bool "combination-lock"
    depends on BR2_PACKAGE_WIRINGPI
    help
      Combination lock using wiringpi
```
